/****************************************************************/
/*   Project: SensorNET                                         */
/*   Subproject: DataAquirer                                    */
/*   Author: Ferusu                                             */
/*   Date: 21/03/2019                                           */
/*   Module: hhal_ser   File: hhal_ser.cpp                      */
/*   Brief:                                                     */
/****************************************************************/

/*****************************************************************/
/*                    General Includes                           */
/*****************************************************************/



/*****************************************************************/
/*                    Project Includes                           */
/*****************************************************************/

#include <hhal_ser.h>

/******************************************************************/
/*            Definition of local symbolic constants              */
/******************************************************************/



/******************************************************************/
/*           Definition of local functions like macros            */
/******************************************************************/



/*****************************************************************/
/*            Typedef of structures and enumerations             */
/*****************************************************************/



/*****************************************************************/
/*                Private Constant Declaration                   */
/*****************************************************************/



/*****************************************************************/
/*                 Private Variable Declaration                  */
/*****************************************************************/

bool dahalSerInitialized = false;

/*****************************************************************/
/*                  Local Function Prototypes                    */
/*****************************************************************/




/*****************************************************************/
/*                  Local Function Declaration                   */
/*****************************************************************/



/*****************************************************************/
/*                  Public Function Declaration                  */
/*****************************************************************/

void HhalSerInit (void)
{
    if(!dahalSerInitialized)
    {
        Serial.begin(115200);
        dahalSerInitialized = true;
    }
}

bool HhalSerAvailableData(void)
{
    bool returnValue = false;
    if (dahalSerInitialized)
    {
        returnValue = (Serial.available()!=0)?true:false;
    }
    return returnValue;
}

char HhalSerRead (void)
{
    char returnValue = 0;
    if (dahalSerInitialized)
    {
        returnValue = Serial.read();
    }
    return returnValue;
}

